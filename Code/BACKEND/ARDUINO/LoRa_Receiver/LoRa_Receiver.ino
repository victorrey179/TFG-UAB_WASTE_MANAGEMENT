#include <cstring>

//Librerias para la conexión internet y firebase
#include "Network.h"

//Libreri­as para LoRa
#include <LoRa.h>
#include <SPI.h>

//Libraries para comunicar con y dibujar en la pantalla OLED integrada
#include <Wire.h>
#include <Adafruit_GFX.h>
#include <Adafruit_SSD1306.h>

//Debemos definir los pines que se utilizarÃ¡n por el mÃ³dulo LoRa
#define SCK 5
#define MISO 19
#define MOSI 27
#define SS 18
#define RST 14
#define DIO0 26

//AquÃ­ definimos una frecuencia de operaciÃ³n segÃºn nuestra ubicaciÃ³n. 433E6 para Asia, 868E6 para Europa, 915E6 para AmÃ©rica
#define BAND 868E6

//Definimos los pines necesarios para conectar con pantalla OLED
#define ANCHOPANTALLA 128 // El ancho de la pantalla en pixeles es de 128px
#define ALTOPANTALLA 64 // El ancho de la pantalla en pixeles es de 64px
#define OLED_SDA 4
#define OLED_SCL 15 
#define OLED_RST 16

Adafruit_SSD1306 display(ANCHOPANTALLA, ALTOPANTALLA, &Wire, OLED_RST);

static const unsigned char PROGMEM logo_bmp[] =
{
	0x00, 0x00, 0x07, 0xff, 0xff, 0x80, 0x00, 0x00, 0x00, 0x00, 0x0f, 0xff, 0xff, 0xc0, 0x00, 0x00, 
	0x00, 0x00, 0x0f, 0xff, 0xff, 0xe0, 0x00, 0x00, 0x00, 0x00, 0x1f, 0xff, 0xff, 0xe0, 0x00, 0x00, 
	0x00, 0x00, 0x3f, 0xff, 0xff, 0xf0, 0x00, 0x00, 0x00, 0x00, 0x3f, 0xff, 0xff, 0xf0, 0x00, 0x00, 
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	0x00, 0x7f, 0xff, 0xf8, 0xff, 0xff, 0xf8, 0x00, 0x00, 0x3f, 0xff, 0xf8, 0x7f, 0xff, 0xf0, 0x00
};

const unsigned char logo_bmp2[] PROGMEM = {
	0x01, 0xff, 0x00, 0x01, 0xff, 0x00, 0x03, 0xff, 0x80, 0x03, 0xff, 0x80, 0x07, 0xff, 0xc0, 0x07, 
	0xff, 0xc0, 0x00, 0x0f, 0xe0, 0x1f, 0xef, 0xd0, 0x1f, 0xc7, 0xd0, 0x3f, 0xc7, 0xb8, 0x3f, 0x83, 
	0x78, 0x7f, 0x81, 0x7c, 0x7f, 0x00, 0xfc, 0xfe, 0x00, 0xfe, 0x7f, 0x7f, 0xfc, 0x7f, 0x7f, 0xfc, 
	0x3f, 0xbf, 0xf8, 0x3f, 0xdf, 0xf8, 0x1f, 0xdf, 0xf0, 0x1f, 0xef, 0xf0
};

// 'lora', 32x21px
const unsigned char logo_lora [] PROGMEM = {
	0x03, 0xfc, 0x00, 0x00, 0x04, 0x03, 0x00, 0x00, 0x03, 0xfc, 0x00, 0x00, 0x02, 0x04, 0x00, 0x00, 
	0xc1, 0x99, 0xfe, 0x00, 0xc0, 0x01, 0x8e, 0x00, 0xc1, 0xf9, 0x86, 0x7c, 0xc1, 0x99, 0x8e, 0xcc, 
	0xc3, 0x0d, 0xfc, 0x3c, 0xc3, 0x0d, 0x9c, 0xec, 0xfd, 0x9d, 0x8c, 0xcc, 0xfd, 0xf9, 0x8e, 0xfc, 
	0x00, 0x60, 0x00, 0x20, 0x01, 0x08, 0x00, 0x00, 0x00, 0x60, 0x00, 0x00, 0x03, 0x9c, 0x00, 0x00, 
	0x04, 0x72, 0x00, 0x00, 0x07, 0xfe, 0x00, 0x00, 0x00, 0xf0, 0x00, 0x00
};

String DatoLoRa;//Cadena de texto para recibir datos del otro LoRa.
Network *network;

void initNetwork(){
  network = new Network();
  network->initWiFi();
}


void setup() { 
  //initialize Serial Monitor
  Serial.begin(115200);
  initNetwork();
  pinMode(OLED_RST, OUTPUT);//reseteamos la pantalla OLED para comenzar
  digitalWrite(OLED_RST, LOW);
  delay(20);
  digitalWrite(OLED_RST, HIGH);
  
  Wire.begin(OLED_SDA, OLED_SCL); //inicia OLED
  if(!display.begin(SSD1306_SWITCHCAPVCC, 0x3c, false, false)) { // 0x3C representa 128x32
    Serial.println(F("Fallo iniciando SSD1306"));
    for(;;); // Si detecta el fallo anterior, detiene el cÃ³digo aquÃ­ hasta que se reinicie
  }

  SPI.begin(SCK, MISO, MOSI, SS);  //Definimos pines SPI
  LoRa.setPins(SS, RST, DIO0); //Configuramos el LoRa para enviar

  display.setTextSize(1); // Con un tamaño de 1, cada caracter es de 6x8 píxeles
  display.clearDisplay();
  display.setTextColor(WHITE);

  
  if (!LoRa.begin(BAND)) {//Intenta transmitir en la banda elegida
    Serial.println("Error iniciando LoRa");//Si no puede transmitir, marca error
    while (1);
  }

  display.clearDisplay();
  display.drawBitmap((ANCHOPANTALLA - 62) / 2, (ALTOPANTALLA - 54) / 2, 
                     logo_bmp, 62, 54, WHITE);
  display.display();
  delay(2000);//Esperamos tres segundos
}

void loop() {

  int tamanoPaquete = LoRa.parsePacket();  //analizamos paquete
  if (tamanoPaquete) {//Si nos llega paquete de datos
    Serial.print("Paquete recibido ");//Muestra confirmaciÃ³n

    while (LoRa.available()) {//Leemos el paquete
      DatoLoRa = LoRa.readString();//Guardamos cadena en variable
      Serial.print(DatoLoRa);//Lo imprimimos en monitor serial
    }
  
  // Convertimos DatoLoRa a una cadena de caracteres para usar con strtok
  char str[64]; // Debe ser lo suficientemente grande para contener el dato recibido
  DatoLoRa.toCharArray(str, sizeof(str));

  char* ptr = strtok(str, ",");
  if (ptr != nullptr) {
      String id = ptr; // "Z1_EE_AZUL"
      ptr = strtok(nullptr, ",");
      int t = ptr ? atoi(ptr) : 0;
      ptr = strtok(nullptr, ",");
      int h = ptr ? atoi(ptr) : 0;
      ptr = strtok(nullptr, ",");
      int distance = ptr ? atoi(ptr) : 0;
      ptr = strtok(nullptr, ",");
      int x = ptr ? atoi(ptr) : 0;
      ptr = strtok(nullptr, ",");
      int y = ptr ? atoi(ptr) : 0;
      ptr = strtok(nullptr, ",");
      int z = ptr ? atoi(ptr) : 0;

      display.clearDisplay();//Limpia pantalla
      display.drawBitmap(0, 0, 
                        logo_bmp2, 23, 20, WHITE);
      display.setCursor(27,7);
      display.setTextSize(1);//TamaÃ±o de fuente a 1 punto
      display.print("Blue Campus");
      display.setCursor(0,25);
      display.print("Recibiendo");//Mensaje de confirmaciÃ³n
      display.drawBitmap(98, 0, 
                        logo_lora, 30, 19, WHITE);

      int rssi = LoRa.packetRssi();//Esto nos imprime la intensidad de seÃ±al recibida
      Serial.print(" con RSSI ");    
      Serial.println(rssi);

      display.setCursor(80,23);
      display.print("RSSI: ");//Imprime intensidad de seÃ±al
      display.setCursor(110,23);
      display.print(rssi);

      // Mostramos informaciÃ³n captada
      display.setTextSize(2);//TamaÃ±o de fuente a 2 puntos
      display.setCursor(0,35);
      display.print(t);
      int numberWidth = 0;
      if (t == 0) {
        numberWidth = 6; // Asumiendo que cada carácter es de 6 píxeles de ancho
      } else {
        for (int tempTemperature = t; tempTemperature > 0; tempTemperature /= 10) {
          numberWidth += 6; // Asumiendo que cada carácter es de 6 píxeles de ancho
        }
      }
      // Add a small offset after the number for a space before the unit
      numberWidth += 6; // Añadir, por ejemplo, 6 píxeles de espacio
      // Print the unit
      display.setCursor(0 + numberWidth + 12, 35); // Mueve el cursor a la derecha de la longitud del número
      display.print("C");
      display.setCursor(45,35);
      display.print(h);
      numberWidth = 0;
      if (h == 0) {
        numberWidth = 6; // Asumiendo que cada carácter es de 6 píxeles de ancho
      } else {
        for (int tempHumidity = h; tempHumidity > 0; tempHumidity /= 10) {
          numberWidth += 6; // Asumiendo que cada carácter es de 6 píxeles de ancho
        }
      }
      // Add a small offset after the number for a space before the unit
      numberWidth += 6; // Añadir, por ejemplo, 6 píxeles de espacio
      // Print the unit
      display.setCursor(45 + numberWidth + 5, 35); // Mueve el cursor a la derecha de la longitud del número
      display.print("%");
      display.setCursor(81,35);
      display.print(distance);
      // Calculate the width of the number in pixels
      numberWidth = 0;
      if (distance == 0) {
        numberWidth = 6; // Asumiendo que cada carácter es de 6 píxeles de ancho
      } else {
        for (int tempDistance = distance; tempDistance > 0; tempDistance /= 10) {
          numberWidth += 6; // Asumiendo que cada carácter es de 6 píxeles de ancho
        }
      }
      // Add a small offset after the number for a space before the unit
      numberWidth += 6; // Añadir, por ejemplo, 6 píxeles de espacio
      // Print the unit
      display.setCursor(81 + numberWidth + 5, 35); // Mueve el cursor a la derecha de la longitud del número
      display.print("cm");

      display.setTextSize(1);
      display.setCursor(0 + numberWidth + 5, 33); // Mueve el cursor a la derecha de la longitud del número
      display.print("o");
      display.setCursor(0,55);
      display.print("x:");
      display.setCursor(12,55);
      display.print(x);
      display.setCursor(40,55);
      display.print("y:");
      display.setCursor(52,55);
      display.print(y);
      display.setCursor(80,55);
      display.print("z:");
      display.setCursor(92,55);
      display.print(z);
      display.display();
      network->httpSendRequest(id, rssi, t, h, distance, x, y, z);
      // Ahora puedes usar las variables t, h, distance, x_out, y_out, y z_out para lo que necesites
  }
  }
  }

